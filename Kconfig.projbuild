## Kconfig.projbuild
```kconfig
source "components/ui/Kconfig"
source "components/settings/Kconfig"
source "components/backup/Kconfig"
source "components/i18n/Kconfig"
source "components/scanner/Kconfig"
```

## components/backup/Kconfig
```kconfig
menu "Backup"
config BACKUP_ENABLE
    bool "Enable Wi-Fi backups"
    default y
config BACKUP_WIFI_SSID
    string "Wi-Fi SSID"
    depends on BACKUP_ENABLE
    default "myssid"
config BACKUP_WIFI_PASS
    string "Wi-Fi Password"
    depends on BACKUP_ENABLE
    default "mypassword"
config BACKUP_SERVER_URL
    string "Backup server URL"
    depends on BACKUP_ENABLE
    default "http://example.com/upload"
config BACKUP_AES_KEY
    string "AES encryption key (hex)"
    depends on BACKUP_ENABLE
    default "00112233445566778899aabbccddeeff"
config BACKUP_INTERVAL_HOURS
    int "Automatic backup interval (hours)"
    depends on BACKUP_ENABLE
    default 24
endmenu
```

## components/feeding/Kconfig
```kconfig
menu "Feeding"
config FEEDING_INTERVAL_DAYS
    int "Default feeding interval (days)"
    default 7
endmenu
```

## components/i18n/Kconfig
```kconfig
menu "Language"

choice I18N_LANG
    prompt "UI language"
    default I18N_LANG_EN

config I18N_LANG_EN
    bool "English"

config I18N_LANG_FR
    bool "French"

config I18N_LANG_DE
    bool "German"

config I18N_LANG_ES
    bool "Spanish"

endchoice

endmenu
```

## components/scanner/Kconfig
```kconfig
menu "Scanner"
config SCANNER_ENABLE
    bool "Enable RFID/QR scanner"
    default n
endmenu
```

## components/settings/Kconfig
```kconfig
menu "Settings"
config SETTINGS_TEMP_MIN
    float "Minimum temperature (C)"
    default 20.0
config SETTINGS_TEMP_MAX
    float "Maximum temperature (C)"
    default 30.0
config SETTINGS_HUM_MIN
    float "Minimum humidity (%)"
    default 40.0
config SETTINGS_HUM_MAX
    float "Maximum humidity (%)"
    default 60.0
endmenu
```

## components/ui/Kconfig
```kconfig
menu "UI configuration"

choice UI_DISPLAY_INTERFACE
    prompt "Display driver interface"
    default UI_DISPLAY_INTERFACE_SPI
    help
        Select the hardware interface used to communicate with the display.

config UI_DISPLAY_INTERFACE_SPI
    bool "SPI"

config UI_DISPLAY_INTERFACE_PARALLEL
    bool "8080 parallel"

endchoice

config UI_DISPLAY_WIDTH
    int "Display width"
    range 80 800
    default 320

config UI_DISPLAY_HEIGHT
    int "Display height"
    range 80 800
    default 240

config UI_HIGH_CONTRAST
    bool "High contrast theme"
    default n
    help
        Use a black background with white text for better visibility.

config UI_LARGE_FONT
    bool "Large font mode"
    default n
    help
        Use a 28px font for easier reading.

endmenu
```

## sdkconfig.defaults
```kconfig
# Default configuration for Lizard Manager
CONFIG_IDF_TARGET="esp32"
CONFIG_ESPTOOLPY_PORT="/dev/ttyUSB0"
CONFIG_ESPTOOLPY_BAUD=460800
CONFIG_ESPTOOLPY_MONITOR_BAUD=115200
CONFIG_UI_DISPLAY_INTERFACE_SPI=y
# CONFIG_UI_DISPLAY_INTERFACE_PARALLEL is not set
CONFIG_UI_DISPLAY_WIDTH=320
CONFIG_UI_DISPLAY_HEIGHT=240
CONFIG_PARTITION_TABLE_CUSTOM=y
CONFIG_PARTITION_TABLE_CUSTOM_FILENAME="partitions.csv"
```
